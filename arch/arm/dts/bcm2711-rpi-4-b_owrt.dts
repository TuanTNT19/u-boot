# 1 "arch/arm64/boot/dts/broadcom/bcm2711-rpi-4-b.dts"
# 1 "<built-in>"
# 1 "<command-line>"
# 1 "arch/arm64/boot/dts/broadcom/bcm2711-rpi-4-b.dts"

# 1 "./scripts/dtc/include-prefixes/arm/broadcom/bcm2711-rpi-4-b.dts" 1

/dts-v1/;


# 1 "./scripts/dtc/include-prefixes/arm/broadcom/bcm2711.dtsi" 1

# 1 "./scripts/dtc/include-prefixes/arm/broadcom/bcm283x.dtsi" 1
# 1 "./scripts/dtc/include-prefixes/dt-bindings/pinctrl/bcm2835.h" 1
# 2 "./scripts/dtc/include-prefixes/arm/broadcom/bcm283x.dtsi" 2
# 1 "./scripts/dtc/include-prefixes/dt-bindings/clock/bcm2835.h" 1
# 3 "./scripts/dtc/include-prefixes/arm/broadcom/bcm283x.dtsi" 2
# 1 "./scripts/dtc/include-prefixes/dt-bindings/clock/bcm2835-aux.h" 1
# 4 "./scripts/dtc/include-prefixes/arm/broadcom/bcm283x.dtsi" 2
# 1 "./scripts/dtc/include-prefixes/dt-bindings/gpio/gpio.h" 1
# 5 "./scripts/dtc/include-prefixes/arm/broadcom/bcm283x.dtsi" 2
# 1 "./scripts/dtc/include-prefixes/dt-bindings/interrupt-controller/irq.h" 1
# 6 "./scripts/dtc/include-prefixes/arm/broadcom/bcm283x.dtsi" 2
# 1 "./scripts/dtc/include-prefixes/dt-bindings/soc/bcm2835-pm.h" 1
# 7 "./scripts/dtc/include-prefixes/arm/broadcom/bcm283x.dtsi" 2




/memreserve/ 0x00000000 0x00001000;






/ {
 compatible = "brcm,bcm2835";
 model = "BCM2835";
 #address-cells = <1>;
 #size-cells = <1>;

 aliases {
  serial0 = &uart0;
  serial1 = &uart1;
 };

 chosen {
  stdout-path = "serial0:115200n8";
 };

 rmem: reserved-memory {
  #address-cells = <1>;
  #size-cells = <1>;
  ranges;

  cma: linux,cma {
   compatible = "shared-dma-pool";
   size = <0x4000000>;
   reusable;
   linux,cma-default;
  };
 };

 thermal-zones {
  cpu_thermal: cpu-thermal {
   polling-delay-passive = <0>;
   polling-delay = <1000>;

   trips {
    cpu-crit {
     temperature = <90000>;
     hysteresis = <0>;
     type = "critical";
    };
   };

   cooling-maps {
   };
  };
 };

 soc {
  compatible = "simple-bus";
  #address-cells = <1>;
  #size-cells = <1>;

  system_timer: timer@7e003000 {
   compatible = "brcm,bcm2835-system-timer";
   reg = <0x7e003000 0x1000>;
   interrupts = <1 0>, <1 1>, <1 2>, <1 3>;




   clock-frequency = <1000000>;
  };

  txp: txp@7e004000 {
   compatible = "brcm,bcm2835-txp";
   reg = <0x7e004000 0x20>;
   interrupts = <1 11>;
  };

  clocks: cprman@7e101000 {
   compatible = "brcm,bcm2835-cprman";
   #clock-cells = <1>;
   reg = <0x7e101000 0x2000>;





   clocks = <&clk_osc>,
    <&dsi0 0>, <&dsi0 1>, <&dsi0 2>,
    <&dsi1 0>, <&dsi1 1>, <&dsi1 2>;
  };

  mailbox: mailbox@7e00b880 {
   compatible = "brcm,bcm2835-mbox";
   reg = <0x7e00b880 0x40>;
   interrupts = <0 1>;
   #mbox-cells = <0>;
  };

  gpio: gpio@7e200000 {
   compatible = "brcm,bcm2835-gpio";
   reg = <0x7e200000 0xb4>;
# 121 "./scripts/dtc/include-prefixes/arm/broadcom/bcm283x.dtsi"
   interrupts = <2 17>, <2 18>, <2 19>, <2 20>;

   gpio-controller;
   #gpio-cells = <2>;

   interrupt-controller;
   #interrupt-cells = <2>;

   gpio-ranges = <&gpio 0 0 54>;
# 138 "./scripts/dtc/include-prefixes/arm/broadcom/bcm283x.dtsi"
   dpi_gpio0: dpi-gpio0 {
    brcm,pins = <0 1 2 3 4 5 6 7 8 9 10 11
          12 13 14 15 16 17 18 19
          20 21 22 23 24 25 26 27>;
    brcm,function = <6>;
   };
   emmc_gpio22: emmc-gpio22 {
    brcm,pins = <22 23 24 25 26 27>;
    brcm,function = <7>;
   };
   emmc_gpio34: emmc-gpio34 {
    brcm,pins = <34 35 36 37 38 39>;
    brcm,function = <7>;
    brcm,pull = <0
          2
          2
          2
          2
          2>;
   };
   emmc_gpio48: emmc-gpio48 {
    brcm,pins = <48 49 50 51 52 53>;
    brcm,function = <7>;
   };

   gpclk0_gpio4: gpclk0-gpio4 {
    brcm,pins = <4>;
    brcm,function = <4>;
   };
   gpclk1_gpio5: gpclk1-gpio5 {
    brcm,pins = <5>;
    brcm,function = <4>;
   };
   gpclk1_gpio42: gpclk1-gpio42 {
    brcm,pins = <42>;
    brcm,function = <4>;
   };
   gpclk1_gpio44: gpclk1-gpio44 {
    brcm,pins = <44>;
    brcm,function = <4>;
   };
   gpclk2_gpio6: gpclk2-gpio6 {
    brcm,pins = <6>;
    brcm,function = <4>;
   };
   gpclk2_gpio43: gpclk2-gpio43 {
    brcm,pins = <43>;
    brcm,function = <4>;
    brcm,pull = <0>;
   };

   i2c0_gpio0: i2c0if-gpio0 {
    brcm,pins = <0 1>;
    brcm,function = <4>;
   };
   i2c0_gpio28: i2c0if-gpio28 {
    brcm,pins = <28 29>;
    brcm,function = <4>;
   };
   i2c0_gpio44: i2c0if-gpio44 {
    brcm,pins = <44 45>;
    brcm,function = <5>;
   };
   i2c1_gpio2: i2c1-gpio2 {
    brcm,pins = <2 3>;
    brcm,function = <4>;
   };
   i2c1_gpio44: i2c1-gpio44 {
    brcm,pins = <44 45>;
    brcm,function = <6>;
   };

   jtag_gpio22: jtag-gpio22 {
    brcm,pins = <22 23 24 25 26 27>;
    brcm,function = <3>;
   };

   pcm_gpio18: pcm-gpio18 {
    brcm,pins = <18 19 20 21>;
    brcm,function = <4>;
   };
   pcm_gpio28: pcm-gpio28 {
    brcm,pins = <28 29 30 31>;
    brcm,function = <6>;
   };

   sdhost_gpio48: sdhost-gpio48 {
    brcm,pins = <48 49 50 51 52 53>;
    brcm,function = <4>;
   };

   spi0_gpio7: spi0-gpio7 {
    brcm,pins = <7 8 9 10 11>;
    brcm,function = <4>;
   };
   spi0_gpio35: spi0-gpio35 {
    brcm,pins = <35 36 37 38 39>;
    brcm,function = <4>;
   };
   spi1_gpio16: spi1-gpio16 {
    brcm,pins = <16 17 18 19 20 21>;
    brcm,function = <3>;
   };
   spi2_gpio40: spi2-gpio40 {
    brcm,pins = <40 41 42 43 44 45>;
    brcm,function = <3>;
   };

   uart0_gpio14: uart0-gpio14 {
    brcm,pins = <14 15>;
    brcm,function = <4>;
   };





   uart0_ctsrts_gpio16: uart0-ctsrts-gpio16 {
    brcm,pins = <16 17>;
    brcm,function = <7>;
   };
   uart0_ctsrts_gpio30: uart0-ctsrts-gpio30 {
    brcm,pins = <30 31>;
    brcm,function = <7>;
    brcm,pull = <2 0>;
   };
   uart0_gpio32: uart0-gpio32 {
    brcm,pins = <32 33>;
    brcm,function = <7>;
    brcm,pull = <0 2>;
   };
   uart0_gpio36: uart0-gpio36 {
    brcm,pins = <36 37>;
    brcm,function = <6>;
   };
   uart0_ctsrts_gpio38: uart0-ctsrts-gpio38 {
    brcm,pins = <38 39>;
    brcm,function = <6>;
   };

   uart1_gpio14: uart1-gpio14 {
    brcm,pins = <14 15>;
    brcm,function = <2>;
   };
   uart1_ctsrts_gpio16: uart1-ctsrts-gpio16 {
    brcm,pins = <16 17>;
    brcm,function = <2>;
   };
   uart1_gpio32: uart1-gpio32 {
    brcm,pins = <32 33>;
    brcm,function = <2>;
   };
   uart1_ctsrts_gpio30: uart1-ctsrts-gpio30 {
    brcm,pins = <30 31>;
    brcm,function = <2>;
   };
   uart1_gpio40: uart1-gpio40 {
    brcm,pins = <40 41>;
    brcm,function = <2>;
   };
   uart1_ctsrts_gpio42: uart1-ctsrts-gpio42 {
    brcm,pins = <42 43>;
    brcm,function = <2>;
   };
  };

  uart0: serial@7e201000 {
   compatible = "arm,pl011", "arm,primecell";
   reg = <0x7e201000 0x200>;
   interrupts = <2 25>;
   clocks = <&clocks 19>,
     <&clocks 20>;
   clock-names = "uartclk", "apb_pclk";
   arm,primecell-periphid = <0x00241011>;
  };

  sdhost: mmc@7e202000 {
   compatible = "brcm,bcm2835-sdhost";
   reg = <0x7e202000 0x100>;
   interrupts = <2 24>;
   clocks = <&clocks 20>;
   status = "disabled";
  };

  i2s: i2s@7e203000 {
   compatible = "brcm,bcm2835-i2s";
   reg = <0x7e203000 0x24>;
   clocks = <&clocks 31>;
   status = "disabled";
  };

  spi: spi@7e204000 {
   compatible = "brcm,bcm2835-spi";
   reg = <0x7e204000 0x200>;
   interrupts = <2 22>;
   clocks = <&clocks 20>;
   #address-cells = <1>;
   #size-cells = <0>;
   status = "disabled";
  };

  i2c0if: i2c@7e205000 {
   compatible = "brcm,bcm2835-i2c";
   reg = <0x7e205000 0x200>;
   interrupts = <2 21>;
   clocks = <&clocks 20>;
   #address-cells = <1>;
   #size-cells = <0>;
   status = "disabled";
  };

  dpi: dpi@7e208000 {
   compatible = "brcm,bcm2835-dpi";
   reg = <0x7e208000 0x8c>;
   clocks = <&clocks 20>,
     <&clocks 44>;
   clock-names = "core", "pixel";
   status = "disabled";
  };

  dsi0: dsi@7e209000 {
   compatible = "brcm,bcm2835-dsi0";
   reg = <0x7e209000 0x78>;
   interrupts = <2 4>;
   #address-cells = <1>;
   #size-cells = <0>;
   #clock-cells = <1>;

   clocks = <&clocks 34>,
     <&clocks 47>,
     <&clocks 49>;
   clock-names = "phy", "escape", "pixel";

   clock-output-names = "dsi0_byte",
          "dsi0_ddr2",
          "dsi0_ddr";

   status = "disabled";
  };

  aux: aux@7e215000 {
   compatible = "brcm,bcm2835-aux";
   #clock-cells = <1>;
   reg = <0x7e215000 0x8>;
   clocks = <&clocks 20>;
  };

  uart1: serial@7e215040 {
   compatible = "brcm,bcm2835-aux-uart";
   reg = <0x7e215040 0x40>;
   interrupts = <1 29>;
   clocks = <&aux 0>;
   status = "disabled";
  };

  spi1: spi@7e215080 {
   compatible = "brcm,bcm2835-aux-spi";
   reg = <0x7e215080 0x40>;
   interrupts = <1 29>;
   clocks = <&aux 1>;
   #address-cells = <1>;
   #size-cells = <0>;
   status = "disabled";
  };

  spi2: spi@7e2150c0 {
   compatible = "brcm,bcm2835-aux-spi";
   reg = <0x7e2150c0 0x40>;
   interrupts = <1 29>;
   clocks = <&aux 2>;
   #address-cells = <1>;
   #size-cells = <0>;
   status = "disabled";
  };

  pwm: pwm@7e20c000 {
   compatible = "brcm,bcm2835-pwm";
   reg = <0x7e20c000 0x28>;
   clocks = <&clocks 30>;
   assigned-clocks = <&clocks 30>;
   assigned-clock-rates = <50000000>;
   #pwm-cells = <3>;
   status = "disabled";
  };

  sdhci: mmc@7e300000 {
   compatible = "brcm,bcm2835-sdhci";
   reg = <0x7e300000 0x100>;
   interrupts = <2 30>;
   clocks = <&clocks 28>;
   status = "disabled";
  };

  hvs@7e400000 {
   compatible = "brcm,bcm2835-hvs";
   reg = <0x7e400000 0x6000>;
   interrupts = <2 1>;
  };

  dsi1: dsi@7e700000 {
   compatible = "brcm,bcm2835-dsi1";
   reg = <0x7e700000 0x8c>;
   interrupts = <2 12>;
   #address-cells = <1>;
   #size-cells = <0>;
   #clock-cells = <1>;

   clocks = <&clocks 35>,
     <&clocks 48>,
     <&clocks 50>;
   clock-names = "phy", "escape", "pixel";

   clock-output-names = "dsi1_byte",
          "dsi1_ddr2",
          "dsi1_ddr";

   status = "disabled";
  };

  i2c1: i2c@7e804000 {
   compatible = "brcm,bcm2835-i2c";
   reg = <0x7e804000 0x1000>;
   interrupts = <2 21>;
   clocks = <&clocks 20>;
   #address-cells = <1>;
   #size-cells = <0>;
   status = "disabled";
  };

  usb: usb@7e980000 {
   compatible = "brcm,bcm2835-usb";
   reg = <0x7e980000 0x10000>;
   interrupts = <1 9>;
   #address-cells = <1>;
   #size-cells = <0>;
   clocks = <&clk_usb>;
   clock-names = "otg";
   phys = <&usbphy>;
   phy-names = "usb2-phy";
  };
 };

 clocks {
  compatible = "simple-bus";
  #address-cells = <1>;
  #size-cells = <0>;


  clk_osc: clk-osc {
   compatible = "fixed-clock";
   #clock-cells = <0>;
   clock-output-names = "osc";
   clock-frequency = <19200000>;
  };

  clk_usb: clk-usb {
   compatible = "fixed-clock";
   #clock-cells = <0>;
   clock-output-names = "otg";
   clock-frequency = <480000000>;
  };
 };

 usbphy: phy {
  compatible = "usb-nop-xceiv";
  #phy-cells = <0>;
 };
};
# 3 "./scripts/dtc/include-prefixes/arm/broadcom/bcm2711.dtsi" 2

# 1 "./scripts/dtc/include-prefixes/dt-bindings/interrupt-controller/arm-gic.h" 1
# 5 "./scripts/dtc/include-prefixes/arm/broadcom/bcm2711.dtsi" 2


/ {
 compatible = "brcm,bcm2711";

 #address-cells = <2>;
 #size-cells = <1>;

 interrupt-parent = <&gicv2>;

 vc4: gpu {
  compatible = "brcm,bcm2711-vc5";
  status = "disabled";
 };

 clk_27MHz: clk-27M {
  #clock-cells = <0>;
  compatible = "fixed-clock";
  clock-frequency = <27000000>;
  clock-output-names = "27MHz-clock";
 };

 clk_108MHz: clk-108M {
  #clock-cells = <0>;
  compatible = "fixed-clock";
  clock-frequency = <108000000>;
  clock-output-names = "108MHz-clock";
 };

 soc {






  ranges = <0x7e000000 0x0 0xfe000000 0x01800000>,
    <0x7c000000 0x0 0xfc000000 0x02000000>,
    <0x40000000 0x0 0xff800000 0x00800000>;

  dma-ranges = <0xc0000000 0x0 0x00000000 0x40000000>;





  local_intc: interrupt-controller@40000000 {
   compatible = "brcm,bcm2836-l1-intc";
   reg = <0x40000000 0x100>;
  };

  gicv2: interrupt-controller@40041000 {
   interrupt-controller;
   #interrupt-cells = <3>;
   compatible = "arm,gic-400";
   reg = <0x40041000 0x1000>,
    <0x40042000 0x2000>,
    <0x40044000 0x2000>,
    <0x40046000 0x2000>;
   interrupts = <1 9 ((((1 << (4)) - 1) << 8) |
       4)>;
  };

  avs_monitor: avs-monitor@7d5d2000 {
   compatible = "brcm,bcm2711-avs-monitor",
         "syscon", "simple-mfd";
   reg = <0x7d5d2000 0xf00>;

   thermal: thermal {
    compatible = "brcm,bcm2711-thermal";
    #thermal-sensor-cells = <0>;
   };
  };

  dma: dma-controller@7e007000 {
   compatible = "brcm,bcm2835-dma";
   reg = <0x7e007000 0xb00>;
   interrupts = <0 80 4>,
         <0 81 4>,
         <0 82 4>,
         <0 83 4>,
         <0 84 4>,
         <0 85 4>,
         <0 86 4>,

         <0 87 4>,
         <0 87 4>,
         <0 88 4>,
         <0 88 4>;
   interrupt-names = "dma0",
       "dma1",
       "dma2",
       "dma3",
       "dma4",
       "dma5",
       "dma6",
       "dma7",
       "dma8",
       "dma9",
       "dma10";
   #dma-cells = <1>;
   brcm,dma-channel-mask = <0x07f5>;
  };

  pm: watchdog@7e100000 {
   compatible = "brcm,bcm2711-pm", "brcm,bcm2835-pm-wdt";
   #power-domain-cells = <1>;
   #reset-cells = <1>;
   reg = <0x7e100000 0x114>,
         <0x7e00a000 0x24>,
         <0x7ec11000 0x20>;
   reg-names = "pm", "asb", "rpivid_asb";
   clocks = <&clocks 21>,
     <&clocks 29>,
     <&clocks 23>,
     <&clocks 22>;
   clock-names = "v3d", "peri_image", "h264", "isp";
   system-power-controller;
  };

  rng@7e104000 {
   compatible = "brcm,bcm2711-rng200";
   reg = <0x7e104000 0x28>;
  };

  uart2: serial@7e201400 {
   compatible = "arm,pl011", "arm,primecell";
   reg = <0x7e201400 0x200>;
   interrupts = <0 121 4>;
   clocks = <&clocks 19>,
     <&clocks 20>;
   clock-names = "uartclk", "apb_pclk";
   arm,primecell-periphid = <0x00241011>;
   status = "disabled";
  };

  uart3: serial@7e201600 {
   compatible = "arm,pl011", "arm,primecell";
   reg = <0x7e201600 0x200>;
   interrupts = <0 121 4>;
   clocks = <&clocks 19>,
     <&clocks 20>;
   clock-names = "uartclk", "apb_pclk";
   arm,primecell-periphid = <0x00241011>;
   status = "disabled";
  };

  uart4: serial@7e201800 {
   compatible = "arm,pl011", "arm,primecell";
   reg = <0x7e201800 0x200>;
   interrupts = <0 121 4>;
   clocks = <&clocks 19>,
     <&clocks 20>;
   clock-names = "uartclk", "apb_pclk";
   arm,primecell-periphid = <0x00241011>;
   status = "disabled";
  };

  uart5: serial@7e201a00 {
   compatible = "arm,pl011", "arm,primecell";
   reg = <0x7e201a00 0x200>;
   interrupts = <0 121 4>;
   clocks = <&clocks 19>,
     <&clocks 20>;
   clock-names = "uartclk", "apb_pclk";
   arm,primecell-periphid = <0x00241011>;
   status = "disabled";
  };

  spi3: spi@7e204600 {
   compatible = "brcm,bcm2835-spi";
   reg = <0x7e204600 0x0200>;
   interrupts = <0 118 4>;
   clocks = <&clocks 20>;
   #address-cells = <1>;
   #size-cells = <0>;
   status = "disabled";
  };

  spi4: spi@7e204800 {
   compatible = "brcm,bcm2835-spi";
   reg = <0x7e204800 0x0200>;
   interrupts = <0 118 4>;
   clocks = <&clocks 20>;
   #address-cells = <1>;
   #size-cells = <0>;
   status = "disabled";
  };

  spi5: spi@7e204a00 {
   compatible = "brcm,bcm2835-spi";
   reg = <0x7e204a00 0x0200>;
   interrupts = <0 118 4>;
   clocks = <&clocks 20>;
   #address-cells = <1>;
   #size-cells = <0>;
   status = "disabled";
  };

  spi6: spi@7e204c00 {
   compatible = "brcm,bcm2835-spi";
   reg = <0x7e204c00 0x0200>;
   interrupts = <0 118 4>;
   clocks = <&clocks 20>;
   #address-cells = <1>;
   #size-cells = <0>;
   status = "disabled";
  };

  i2c3: i2c@7e205600 {
   compatible = "brcm,bcm2711-i2c", "brcm,bcm2835-i2c";
   reg = <0x7e205600 0x200>;
   interrupts = <0 117 4>;
   clocks = <&clocks 20>;
   #address-cells = <1>;
   #size-cells = <0>;
   status = "disabled";
  };

  i2c4: i2c@7e205800 {
   compatible = "brcm,bcm2711-i2c", "brcm,bcm2835-i2c";
   reg = <0x7e205800 0x200>;
   interrupts = <0 117 4>;
   clocks = <&clocks 20>;
   #address-cells = <1>;
   #size-cells = <0>;
   status = "disabled";
  };

  i2c5: i2c@7e205a00 {
   compatible = "brcm,bcm2711-i2c", "brcm,bcm2835-i2c";
   reg = <0x7e205a00 0x200>;
   interrupts = <0 117 4>;
   clocks = <&clocks 20>;
   #address-cells = <1>;
   #size-cells = <0>;
   status = "disabled";
  };

  i2c6: i2c@7e205c00 {
   compatible = "brcm,bcm2711-i2c", "brcm,bcm2835-i2c";
   reg = <0x7e205c00 0x200>;
   interrupts = <0 117 4>;
   clocks = <&clocks 20>;
   #address-cells = <1>;
   #size-cells = <0>;
   status = "disabled";
  };

  pixelvalve0: pixelvalve@7e206000 {
   compatible = "brcm,bcm2711-pixelvalve0";
   reg = <0x7e206000 0x100>;
   interrupts = <0 109 4>;
   status = "disabled";
  };

  pixelvalve1: pixelvalve@7e207000 {
   compatible = "brcm,bcm2711-pixelvalve1";
   reg = <0x7e207000 0x100>;
   interrupts = <0 110 4>;
   status = "disabled";
  };

  pixelvalve2: pixelvalve@7e20a000 {
   compatible = "brcm,bcm2711-pixelvalve2";
   reg = <0x7e20a000 0x100>;
   interrupts = <0 101 4>;
   status = "disabled";
  };

  pwm1: pwm@7e20c800 {
   compatible = "brcm,bcm2835-pwm";
   reg = <0x7e20c800 0x28>;
   clocks = <&clocks 30>;
   assigned-clocks = <&clocks 30>;
   assigned-clock-rates = <50000000>;
   #pwm-cells = <3>;
   status = "disabled";
  };

  pixelvalve4: pixelvalve@7e216000 {
   compatible = "brcm,bcm2711-pixelvalve4";
   reg = <0x7e216000 0x100>;
   interrupts = <0 110 4>;
   status = "disabled";
  };

  hvs: hvs@7e400000 {
   compatible = "brcm,bcm2711-hvs";
   reg = <0x7e400000 0x8000>;
   interrupts = <0 97 4>;
  };

  pixelvalve3: pixelvalve@7ec12000 {
   compatible = "brcm,bcm2711-pixelvalve3";
   reg = <0x7ec12000 0x100>;
   interrupts = <0 106 4>;
   status = "disabled";
  };

  vec: vec@7ec13000 {
   compatible = "brcm,bcm2711-vec";
   reg = <0x7ec13000 0x1000>;
   clocks = <&clocks 24>;
   interrupts = <0 123 4>;
   status = "disabled";
  };

  dvp: clock@7ef00000 {
   compatible = "brcm,brcm2711-dvp";
   reg = <0x7ef00000 0x10>;
   clocks = <&clk_108MHz>;
   #clock-cells = <1>;
   #reset-cells = <1>;
  };

  aon_intr: interrupt-controller@7ef00100 {
   compatible = "brcm,bcm2711-l2-intc", "brcm,l2-intc";
   reg = <0x7ef00100 0x30>;
   interrupts = <0 96 4>;
   interrupt-controller;
   #interrupt-cells = <1>;
  };

  hdmi0: hdmi@7ef00700 {
   compatible = "brcm,bcm2711-hdmi0";
   reg = <0x7ef00700 0x300>,
         <0x7ef00300 0x200>,
         <0x7ef00f00 0x80>,
         <0x7ef00f80 0x80>,
         <0x7ef01b00 0x200>,
         <0x7ef01f00 0x400>,
         <0x7ef00200 0x80>,
         <0x7ef04300 0x100>,
         <0x7ef20000 0x100>;
   reg-names = "hdmi",
        "dvp",
        "phy",
        "rm",
        "packet",
        "metadata",
        "csc",
        "cec",
        "hd";
   clock-names = "hdmi", "bvb", "audio", "cec";
   resets = <&dvp 0>;
   interrupt-parent = <&aon_intr>;
   interrupts = <0>, <1>, <2>,
         <3>, <4>, <5>;
   interrupt-names = "cec-tx", "cec-rx", "cec-low",
       "wakeup", "hpd-connected", "hpd-removed";
   ddc = <&ddc0>;
   dmas = <&dma 10>;
   dma-names = "audio-rx";
   status = "disabled";
  };

  ddc0: i2c@7ef04500 {
   compatible = "brcm,bcm2711-hdmi-i2c";
   reg = <0x7ef04500 0x100>, <0x7ef00b00 0x300>;
   reg-names = "bsc", "auto-i2c";
   clock-frequency = <97500>;
   status = "disabled";
  };

  hdmi1: hdmi@7ef05700 {
   compatible = "brcm,bcm2711-hdmi1";
   reg = <0x7ef05700 0x300>,
         <0x7ef05300 0x200>,
         <0x7ef05f00 0x80>,
         <0x7ef05f80 0x80>,
         <0x7ef06b00 0x200>,
         <0x7ef06f00 0x400>,
         <0x7ef00280 0x80>,
         <0x7ef09300 0x100>,
         <0x7ef20000 0x100>;
   reg-names = "hdmi",
        "dvp",
        "phy",
        "rm",
        "packet",
        "metadata",
        "csc",
        "cec",
        "hd";
   ddc = <&ddc1>;
   clock-names = "hdmi", "bvb", "audio", "cec";
   resets = <&dvp 1>;
   interrupt-parent = <&aon_intr>;
   interrupts = <8>, <7>, <6>,
         <9>, <10>, <11>;
   interrupt-names = "cec-tx", "cec-rx", "cec-low",
       "wakeup", "hpd-connected", "hpd-removed";
   dmas = <&dma 17>;
   dma-names = "audio-rx";
   status = "disabled";
  };

  ddc1: i2c@7ef09500 {
   compatible = "brcm,bcm2711-hdmi-i2c";
   reg = <0x7ef09500 0x100>, <0x7ef05b00 0x300>;
   reg-names = "bsc", "auto-i2c";
   clock-frequency = <97500>;
   status = "disabled";
  };
 };







 emmc2bus: emmc2bus {
  compatible = "simple-bus";
  #address-cells = <2>;
  #size-cells = <1>;

  ranges = <0x0 0x7e000000 0x0 0xfe000000 0x01800000>;
  dma-ranges = <0x0 0xc0000000 0x0 0x00000000 0x40000000>;

  emmc2: mmc@7e340000 {
   compatible = "brcm,bcm2711-emmc2";
   reg = <0x0 0x7e340000 0x100>;
   interrupts = <0 126 4>;
   clocks = <&clocks 51>;
   status = "disabled";
  };
 };

 arm-pmu {
  compatible = "arm,cortex-a72-pmu", "arm,armv8-pmuv3";
  interrupts = <0 16 4>,
   <0 17 4>,
   <0 18 4>,
   <0 19 4>;
  interrupt-affinity = <&cpu0>, <&cpu1>, <&cpu2>, <&cpu3>;
 };

 timer {
  compatible = "arm,armv8-timer";
  interrupts = <1 13 ((((1 << (4)) - 1) << 8) |
       8)>,
        <1 14 ((((1 << (4)) - 1) << 8) |
       8)>,
        <1 11 ((((1 << (4)) - 1) << 8) |
       8)>,
        <1 10 ((((1 << (4)) - 1) << 8) |
       8)>;

  arm,cpu-registers-not-fw-configured;
 };

 cpus: cpus {
  #address-cells = <1>;
  #size-cells = <0>;
  enable-method = "brcm,bcm2836-smp";
# 470 "./scripts/dtc/include-prefixes/arm/broadcom/bcm2711.dtsi"
  cpu0: cpu@0 {
   device_type = "cpu";
   compatible = "arm,cortex-a72";
   reg = <0>;
   enable-method = "spin-table";
   cpu-release-addr = <0x0 0x000000d8>;
   d-cache-size = <0x8000>;
   d-cache-line-size = <64>;
   d-cache-sets = <256>;
   i-cache-size = <0xc000>;
   i-cache-line-size = <64>;
   i-cache-sets = <256>;
   next-level-cache = <&l2>;
  };

  cpu1: cpu@1 {
   device_type = "cpu";
   compatible = "arm,cortex-a72";
   reg = <1>;
   enable-method = "spin-table";
   cpu-release-addr = <0x0 0x000000e0>;
   d-cache-size = <0x8000>;
   d-cache-line-size = <64>;
   d-cache-sets = <256>;
   i-cache-size = <0xc000>;
   i-cache-line-size = <64>;
   i-cache-sets = <256>;
   next-level-cache = <&l2>;
  };

  cpu2: cpu@2 {
   device_type = "cpu";
   compatible = "arm,cortex-a72";
   reg = <2>;
   enable-method = "spin-table";
   cpu-release-addr = <0x0 0x000000e8>;
   d-cache-size = <0x8000>;
   d-cache-line-size = <64>;
   d-cache-sets = <256>;
   i-cache-size = <0xc000>;
   i-cache-line-size = <64>;
   i-cache-sets = <256>;
   next-level-cache = <&l2>;
  };

  cpu3: cpu@3 {
   device_type = "cpu";
   compatible = "arm,cortex-a72";
   reg = <3>;
   enable-method = "spin-table";
   cpu-release-addr = <0x0 0x000000f0>;
   d-cache-size = <0x8000>;
   d-cache-line-size = <64>;
   d-cache-sets = <256>;
   i-cache-size = <0xc000>;
   i-cache-line-size = <64>;
   i-cache-sets = <256>;
   next-level-cache = <&l2>;
  };
# 537 "./scripts/dtc/include-prefixes/arm/broadcom/bcm2711.dtsi"
  l2: l2-cache0 {
   compatible = "cache";
   cache-unified;
   cache-size = <0x100000>;
   cache-line-size = <64>;
   cache-sets = <1024>;
   cache-level = <2>;
  };
 };

 scb {
  compatible = "simple-bus";
  #address-cells = <2>;
  #size-cells = <1>;

  ranges = <0x0 0x7c000000 0x0 0xfc000000 0x03800000>,
    <0x6 0x00000000 0x6 0x00000000 0x40000000>;

  pcie0: pcie@7d500000 {
   compatible = "brcm,bcm2711-pcie";
   reg = <0x0 0x7d500000 0x9310>;
   device_type = "pci";
   #address-cells = <3>;
   #interrupt-cells = <1>;
   #size-cells = <2>;
   interrupts = <0 147 4>,
         <0 148 4>;
   interrupt-names = "pcie", "msi";
   interrupt-map-mask = <0x0 0x0 0x0 0x7>;
   interrupt-map = <0 0 0 1 &gicv2 0 143
       4>,
     <0 0 0 2 &gicv2 0 144
       4>,
     <0 0 0 3 &gicv2 0 145
       4>,
     <0 0 0 4 &gicv2 0 146
       4>;
   msi-controller;
   msi-parent = <&pcie0>;

   ranges = <0x02000000 0x0 0xf8000000 0x6 0x00000000
      0x0 0x04000000>;





   dma-ranges = <0x02000000 0x0 0x00000000 0x0 0x00000000
          0x0 0xc0000000>;
   brcm,enable-ssc;
  };

  genet: ethernet@7d580000 {
   compatible = "brcm,bcm2711-genet-v5";
   reg = <0x0 0x7d580000 0x10000>;
   #address-cells = <0x1>;
   #size-cells = <0x1>;
   interrupts = <0 157 4>,
         <0 158 4>;
   status = "disabled";

   genet_mdio: mdio@e14 {
    compatible = "brcm,genet-mdio-v5";
    reg = <0xe14 0x8>;
    reg-names = "mdio";
    #address-cells = <0x1>;
    #size-cells = <0x0>;
   };
  };

  v3d: gpu@7ec00000 {
   compatible = "brcm,2711-v3d";
   reg = <0x0 0x7ec00000 0x4000>,
         <0x0 0x7ec04000 0x4000>;
   reg-names = "hub", "core0";

   power-domains = <&pm 1>;
   resets = <&pm 0>;
   interrupts = <0 74 4>;
  };
 };
};

&clk_osc {
 clock-frequency = <54000000>;
};

&clocks {
 compatible = "brcm,bcm2711-cprman";
};

&cpu_thermal {
 coefficients = <(-487) 410040>;
 thermal-sensors = <&thermal>;
};

&dsi0 {
 interrupts = <0 100 4>;
};

&dsi1 {
 interrupts = <0 108 4>;
 compatible = "brcm,bcm2711-dsi1";
};

&gpio {
 compatible = "brcm,bcm2711-gpio";
 interrupts = <0 113 4>,
       <0 114 4>,
       <0 115 4>,
       <0 116 4>;

 gpio-ranges = <&gpio 0 0 58>;

 gpclk0_gpio49: gpclk0-gpio49 {
  pin-gpclk {
   pins = "gpio49";
   function = "alt1";
   bias-disable;
  };
 };
 gpclk1_gpio50: gpclk1-gpio50 {
  pin-gpclk {
   pins = "gpio50";
   function = "alt1";
   bias-disable;
  };
 };
 gpclk2_gpio51: gpclk2-gpio51 {
  pin-gpclk {
   pins = "gpio51";
   function = "alt1";
   bias-disable;
  };
 };

 i2c0_gpio46: i2c0if-gpio46 {
  pin-sda {
   function = "alt0";
   pins = "gpio46";
   bias-pull-up;
  };
  pin-scl {
   function = "alt0";
   pins = "gpio47";
   bias-disable;
  };
 };
 i2c1_gpio46: i2c1-gpio46 {
  pin-sda {
   function = "alt1";
   pins = "gpio46";
   bias-pull-up;
  };
  pin-scl {
   function = "alt1";
   pins = "gpio47";
   bias-disable;
  };
 };
 i2c3_gpio2: i2c3-gpio2 {
  pin-sda {
   function = "alt5";
   pins = "gpio2";
   bias-pull-up;
  };
  pin-scl {
   function = "alt5";
   pins = "gpio3";
   bias-disable;
  };
 };
 i2c3_gpio4: i2c3-gpio4 {
  pin-sda {
   function = "alt5";
   pins = "gpio4";
   bias-pull-up;
  };
  pin-scl {
   function = "alt5";
   pins = "gpio5";
   bias-disable;
  };
 };
 i2c4_gpio6: i2c4-gpio6 {
  pin-sda {
   function = "alt5";
   pins = "gpio6";
   bias-pull-up;
  };
  pin-scl {
   function = "alt5";
   pins = "gpio7";
   bias-disable;
  };
 };
 i2c4_gpio8: i2c4-gpio8 {
  pin-sda {
   function = "alt5";
   pins = "gpio8";
   bias-pull-up;
  };
  pin-scl {
   function = "alt5";
   pins = "gpio9";
   bias-disable;
  };
 };
 i2c5_gpio10: i2c5-gpio10 {
  pin-sda {
   function = "alt5";
   pins = "gpio10";
   bias-pull-up;
  };
  pin-scl {
   function = "alt5";
   pins = "gpio11";
   bias-disable;
  };
 };
 i2c5_gpio12: i2c5-gpio12 {
  pin-sda {
   function = "alt5";
   pins = "gpio12";
   bias-pull-up;
  };
  pin-scl {
   function = "alt5";
   pins = "gpio13";
   bias-disable;
  };
 };
 i2c6_gpio0: i2c6-gpio0 {
  pin-sda {
   function = "alt5";
   pins = "gpio0";
   bias-pull-up;
  };
  pin-scl {
   function = "alt5";
   pins = "gpio1";
   bias-disable;
  };
 };
 i2c6_gpio22: i2c6-gpio22 {
  pin-sda {
   function = "alt5";
   pins = "gpio22";
   bias-pull-up;
  };
  pin-scl {
   function = "alt5";
   pins = "gpio23";
   bias-disable;
  };
 };
 i2c_slave_gpio8: i2c-slave-gpio8 {
  pins-i2c-slave {
   pins = "gpio8",
          "gpio9",
          "gpio10",
          "gpio11";
   function = "alt3";
  };
 };

 jtag_gpio48: jtag-gpio48 {
  pins-jtag {
   pins = "gpio48",
          "gpio49",
          "gpio50",
          "gpio51",
          "gpio52",
          "gpio53";
   function = "alt4";
  };
 };

 mii_gpio28: mii-gpio28 {
  pins-mii {
   pins = "gpio28",
          "gpio29",
          "gpio30",
          "gpio31";
   function = "alt4";
  };
 };
 mii_gpio36: mii-gpio36 {
  pins-mii {
   pins = "gpio36",
          "gpio37",
          "gpio38",
          "gpio39";
   function = "alt5";
  };
 };

 pcm_gpio50: pcm-gpio50 {
  pins-pcm {
   pins = "gpio50",
          "gpio51",
          "gpio52",
          "gpio53";
   function = "alt2";
  };
 };

 pwm0_0_gpio12: pwm0-0-gpio12 {
  pin-pwm {
   pins = "gpio12";
   function = "alt0";
   bias-disable;
  };
 };
 pwm0_0_gpio18: pwm0-0-gpio18 {
  pin-pwm {
   pins = "gpio18";
   function = "alt5";
   bias-disable;
  };
 };
 pwm1_0_gpio40: pwm1-0-gpio40 {
  pin-pwm {
   pins = "gpio40";
   function = "alt0";
   bias-disable;
  };
 };
 pwm0_1_gpio13: pwm0-1-gpio13 {
  pin-pwm {
   pins = "gpio13";
   function = "alt0";
   bias-disable;
  };
 };
 pwm0_1_gpio19: pwm0-1-gpio19 {
  pin-pwm {
   pins = "gpio19";
   function = "alt5";
   bias-disable;
  };
 };
 pwm1_1_gpio41: pwm1-1-gpio41 {
  pin-pwm {
   pins = "gpio41";
   function = "alt0";
   bias-disable;
  };
 };
 pwm0_1_gpio45: pwm0-1-gpio45 {
  pin-pwm {
   pins = "gpio45";
   function = "alt0";
   bias-disable;
  };
 };
 pwm0_0_gpio52: pwm0-0-gpio52 {
  pin-pwm {
   pins = "gpio52";
   function = "alt1";
   bias-disable;
  };
 };
 pwm0_1_gpio53: pwm0-1-gpio53 {
  pin-pwm {
   pins = "gpio53";
   function = "alt1";
   bias-disable;
  };
 };

 rgmii_gpio35: rgmii-gpio35 {
  pin-start-stop {
   pins = "gpio35";
   function = "alt4";
  };
  pin-rx-ok {
   pins = "gpio36";
   function = "alt4";
  };
 };
 rgmii_irq_gpio34: rgmii-irq-gpio34 {
  pin-irq {
   pins = "gpio34";
   function = "alt5";
  };
 };
 rgmii_irq_gpio39: rgmii-irq-gpio39 {
  pin-irq {
   pins = "gpio39";
   function = "alt4";
  };
 };
 rgmii_mdio_gpio28: rgmii-mdio-gpio28 {
  pins-mdio {
   pins = "gpio28",
          "gpio29";
   function = "alt5";
  };
 };
 rgmii_mdio_gpio37: rgmii-mdio-gpio37 {
  pins-mdio {
   pins = "gpio37",
          "gpio38";
   function = "alt4";
  };
 };

 spi0_gpio46: spi0-gpio46 {
  pins-spi {
   pins = "gpio46",
          "gpio47",
          "gpio48",
          "gpio49";
   function = "alt2";
  };
 };
 spi2_gpio46: spi2-gpio46 {
  pins-spi {
   pins = "gpio46",
          "gpio47",
          "gpio48",
          "gpio49",
          "gpio50";
   function = "alt5";
  };
 };
 spi3_gpio0: spi3-gpio0 {
  pins-spi {
   pins = "gpio0",
          "gpio1",
          "gpio2",
          "gpio3";
   function = "alt3";
  };
 };
 spi4_gpio4: spi4-gpio4 {
  pins-spi {
   pins = "gpio4",
          "gpio5",
          "gpio6",
          "gpio7";
   function = "alt3";
  };
 };
 spi5_gpio12: spi5-gpio12 {
  pins-spi {
   pins = "gpio12",
          "gpio13",
          "gpio14",
          "gpio15";
   function = "alt3";
  };
 };
 spi6_gpio18: spi6-gpio18 {
  pins-spi {
   pins = "gpio18",
          "gpio19",
          "gpio20",
          "gpio21";
   function = "alt3";
  };
 };

 uart2_gpio0: uart2-gpio0 {
  pin-tx {
   pins = "gpio0";
   function = "alt4";
   bias-disable;
  };
  pin-rx {
   pins = "gpio1";
   function = "alt4";
   bias-pull-up;
  };
 };
 uart2_ctsrts_gpio2: uart2-ctsrts-gpio2 {
  pin-cts {
   pins = "gpio2";
   function = "alt4";
   bias-pull-up;
  };
  pin-rts {
   pins = "gpio3";
   function = "alt4";
   bias-disable;
  };
 };
 uart3_gpio4: uart3-gpio4 {
  pin-tx {
   pins = "gpio4";
   function = "alt4";
   bias-disable;
  };
  pin-rx {
   pins = "gpio5";
   function = "alt4";
   bias-pull-up;
  };
 };
 uart3_ctsrts_gpio6: uart3-ctsrts-gpio6 {
  pin-cts {
   pins = "gpio6";
   function = "alt4";
   bias-pull-up;
  };
  pin-rts {
   pins = "gpio7";
   function = "alt4";
   bias-disable;
  };
 };
 uart4_gpio8: uart4-gpio8 {
  pin-tx {
   pins = "gpio8";
   function = "alt4";
   bias-disable;
  };
  pin-rx {
   pins = "gpio9";
   function = "alt4";
   bias-pull-up;
  };
 };
 uart4_ctsrts_gpio10: uart4-ctsrts-gpio10 {
  pin-cts {
   pins = "gpio10";
   function = "alt4";
   bias-pull-up;
  };
  pin-rts {
   pins = "gpio11";
   function = "alt4";
   bias-disable;
  };
 };
 uart5_gpio12: uart5-gpio12 {
  pin-tx {
   pins = "gpio12";
   function = "alt4";
   bias-disable;
  };
  pin-rx {
   pins = "gpio13";
   function = "alt4";
   bias-pull-up;
  };
 };
 uart5_ctsrts_gpio14: uart5-ctsrts-gpio14 {
  pin-cts {
   pins = "gpio14";
   function = "alt4";
   bias-pull-up;
  };
  pin-rts {
   pins = "gpio15";
   function = "alt4";
   bias-disable;
  };
 };
};

&rmem {
 #address-cells = <2>;
};

&cma {





 alloc-ranges = <0x0 0x00000000 0x40000000>;
};

&i2c0if {
 compatible = "brcm,bcm2711-i2c", "brcm,bcm2835-i2c";
 interrupts = <0 117 4>;
};

&i2c1 {
 compatible = "brcm,bcm2711-i2c", "brcm,bcm2835-i2c";
 interrupts = <0 117 4>;
};

&mailbox {
 interrupts = <0 33 4>;
};

&sdhci {
 interrupts = <0 126 4>;
};

&sdhost {
 interrupts = <0 120 4>;
};

&spi {
 interrupts = <0 118 4>;
};

&spi1 {
 interrupts = <0 93 4>;
};

&spi2 {
 interrupts = <0 93 4>;
};

&system_timer {
 interrupts = <0 64 4>,
       <0 65 4>,
       <0 66 4>,
       <0 67 4>;
};

&txp {
 interrupts = <0 75 4>;
};

&uart0 {
 interrupts = <0 121 4>;
};

&uart1 {
 interrupts = <0 93 4>;
};

&usb {
 interrupts = <0 73 4>;
};

&vec {
 compatible = "brcm,bcm2711-vec";
 interrupts = <0 123 4>;
};
# 6 "./scripts/dtc/include-prefixes/arm/broadcom/bcm2711-rpi-4-b.dts" 2
# 1 "./scripts/dtc/include-prefixes/arm/broadcom/bcm283x-rpi-wifi-bt.dtsi" 1


/ {
 wifi_pwrseq: wifi-pwrseq {
  compatible = "mmc-pwrseq-simple";
 };
};


&sdhci {
 #address-cells = <1>;
 #size-cells = <0>;
 pinctrl-names = "default";
 pinctrl-0 = <&emmc_gpio34>;
 bus-width = <4>;
 non-removable;
 mmc-pwrseq = <&wifi_pwrseq>;
 status = "okay";

 brcmf: wifi@1 {
  reg = <1>;
  compatible = "brcm,bcm4329-fmac";
 };
};


&uart0 {
 status = "okay";

 bt: bluetooth {
  compatible = "brcm,bcm43438-bt";
  max-speed = <2000000>;
 };
};
# 7 "./scripts/dtc/include-prefixes/arm/broadcom/bcm2711-rpi-4-b.dts" 2

# 1 "./scripts/dtc/include-prefixes/arm/broadcom/bcm270x.dtsi" 1

# 1 "./scripts/dtc/include-prefixes/dt-bindings/power/raspberrypi-power.h" 1
# 3 "./scripts/dtc/include-prefixes/arm/broadcom/bcm270x.dtsi" 2

/ {
 chosen: chosen {

  bootargs = "coherent_pool=1M snd_bcm2835.enable_headphones=0 cgroup_disable=memory";
  stdout-path = "serial0:115200n8";
 };

 soc: soc {
  watchdog: watchdog@7e100000 {

  };

  random: rng@7e104000 {

  };

  spi0: spi@7e204000 {

  };
# 36 "./scripts/dtc/include-prefixes/arm/broadcom/bcm270x.dtsi"
  /delete-node/ mmc@7e300000;

  sdhci: mmc: mmc@7e300000 {
   compatible = "brcm,bcm2835-mmc", "brcm,bcm2835-sdhci";
   reg = <0x7e300000 0x100>;
   interrupts = <2 30>;
   clocks = <&clocks 28>;
   dmas = <&dma 11>;
   dma-names = "rx-tx";
   brcm,overclock-50 = <0>;
   status = "disabled";
  };


  mmcnr: mmcnr@7e300000 {
   compatible = "brcm,bcm2835-mmc", "brcm,bcm2835-sdhci";
   reg = <0x7e300000 0x100>;
   interrupts = <2 30>;
   clocks = <&clocks 28>;
   dmas = <&dma 11>;
   dma-names = "rx-tx";
   brcm,overclock-50 = <0>;
   non-removable;
   status = "disabled";
  };

  hvs: hvs@7e400000 {

   status = "disabled";
  };

  firmwarekms: firmwarekms@7e600000 {
   compatible = "raspberrypi,rpi-firmware-kms";

   reg = <0x7e600000 0x100>;
   interrupts = <2 16>;
   brcm,firmware = <&firmware>;
   status = "disabled";
  };

  smi: smi@7e600000 {
   compatible = "brcm,bcm2835-smi";
   reg = <0x7e600000 0x100>;
   interrupts = <2 16>;
   clocks = <&clocks 42>;
   assigned-clocks = <&clocks 42>;
   assigned-clock-rates = <125000000>;
   dmas = <&dma 4>;
   dma-names = "rx-tx";
   status = "disabled";
  };

  csi0: csi@7e800000 {
   compatible = "brcm,bcm2835-unicam";
   reg = <0x7e800000 0x800>,
         <0x7e802000 0x4>;
   interrupts = <2 6>;
   clocks = <&clocks 45>,
     <&firmware_clocks 4>;
   clock-names = "lp", "vpu";
   power-domains = <&power 12>;
   #address-cells = <1>;
   #size-cells = <0>;
   #clock-cells = <1>;
   status = "disabled";
  };

  csi1: csi@7e801000 {
   compatible = "brcm,bcm2835-unicam";
   reg = <0x7e801000 0x800>,
         <0x7e802004 0x4>;
   interrupts = <2 7>;
   clocks = <&clocks 46>,
     <&firmware_clocks 4>;
   clock-names = "lp", "vpu";
   power-domains = <&power 13>;
   #address-cells = <1>;
   #size-cells = <0>;
   #clock-cells = <1>;
   status = "disabled";
  };
# 125 "./scripts/dtc/include-prefixes/arm/broadcom/bcm270x.dtsi"
  hdmi@7e902000 {
   status = "disabled";
  };

  usb@7e980000 {
   compatible = "brcm,bcm2708-usb";
   reg = <0x7e980000 0x10000>,
         <0x7e006000 0x1000>;
   interrupt-names = "usb",
       "soft";
   interrupts = <1 9>,
         <2 0>;
  };
# 147 "./scripts/dtc/include-prefixes/arm/broadcom/bcm270x.dtsi"
  axiperf: axiperf {
   compatible = "brcm,bcm2835-axiperf";
   reg = <0x7e009800 0x100>,
         <0x7ee08000 0x100>;
   firmware = <&firmware>;
   status = "disabled";
  };

  i2c0mux: i2c0mux {
   compatible = "i2c-mux-pinctrl";
   #address-cells = <1>;
   #size-cells = <0>;

   i2c-parent = <&i2c0if>;

   status = "disabled";

   i2c0: i2c@0 {
    reg = <0>;
    #address-cells = <1>;
    #size-cells = <0>;
   };

   i2c_csi_dsi: i2c@1 {
    reg = <1>;
    #address-cells = <1>;
    #size-cells = <0>;
   };
  };
 };

 cam1_reg: cam1_regulator {
  compatible = "regulator-fixed";
  regulator-name = "cam1-reg";
  enable-active-high;

  status = "okay";
 };

 cam1_clk: cam1_clk {
  compatible = "fixed-clock";
  #clock-cells = <0>;
  status = "disabled";
 };

 cam0_regulator: cam0_regulator {
  compatible = "regulator-fixed";
  regulator-name = "cam0-reg";
  enable-active-high;
  status = "disabled";
 };

 cam0_clk: cam0_clk {
  compatible = "fixed-clock";
  #clock-cells = <0>;
  status = "disabled";
 };

 cam_dummy_reg: cam_dummy_reg {
  compatible = "regulator-fixed";
  regulator-name = "cam-dummy-reg";
  status = "okay";
 };

 __overrides__ {
  cam0-pwdn-ctrl;
  cam0-pwdn;
  cam0-led-ctrl;
  cam0-led;
 };
};

&gpio {
 interrupts = <2 17>, <2 18>;

 dpi_18bit_cpadhi_gpio0: dpi_18bit_cpadhi_gpio0 {
  brcm,pins = <0 1 2 3 4 5 6 7 8 9
        12 13 14 15 16 17
        20 21 22 23 24 25>;
  brcm,function = <6>;
  brcm,pull = <0>;
 };
 dpi_18bit_cpadhi_gpio2: dpi_18bit_cpadhi_gpio2 {
  brcm,pins = <2 3 4 5 6 7 8 9
        12 13 14 15 16 17
        20 21 22 23 24 25>;
  brcm,function = <6>;
 };
 dpi_18bit_gpio0: dpi_18bit_gpio0 {
  brcm,pins = <0 1 2 3 4 5 6 7 8 9 10 11
        12 13 14 15 16 17 18 19
        20 21>;
  brcm,function = <6>;
 };
 dpi_18bit_gpio2: dpi_18bit_gpio2 {
  brcm,pins = <2 3 4 5 6 7 8 9 10 11
        12 13 14 15 16 17 18 19
        20 21>;
  brcm,function = <6>;
 };
 dpi_16bit_gpio0: dpi_16bit_gpio0 {
  brcm,pins = <0 1 2 3 4 5 6 7 8 9 10 11
        12 13 14 15 16 17 18 19>;
  brcm,function = <6>;
 };
 dpi_16bit_gpio2: dpi_16bit_gpio2 {
  brcm,pins = <2 3 4 5 6 7 8 9 10 11
        12 13 14 15 16 17 18 19>;
  brcm,function = <6>;
 };
 dpi_16bit_cpadhi_gpio0: dpi_16bit_cpadhi_gpio0 {
  brcm,pins = <0 1 2 3 4 5 6 7 8
        12 13 14 15 16 17
        20 21 22 23 24>;
  brcm,function = <6>;
 };
 dpi_16bit_cpadhi_gpio2: dpi_16bit_cpadhi_gpio2 {
  brcm,pins = <2 3 4 5 6 7 8
        12 13 14 15 16 17
        20 21 22 23 24>;
  brcm,function = <6>;
 };
};

&uart0 {

 cts-event-workaround;
};

&i2s {
 #sound-dai-cells = <0>;
 dmas = <&dma 2>, <&dma 3>;
 dma-names = "tx", "rx";
};

&sdhost {
 dmas = <&dma (13|(1<<29))>;
 dma-names = "rx-tx";
 bus-width = <4>;
 brcm,overclock-50 = <0>;
 brcm,pio-limit = <1>;
 firmware = <&firmware>;
};

&spi0 {
 dmas = <&dma 6>, <&dma 7>;
 dma-names = "tx", "rx";
};
# 9 "./scripts/dtc/include-prefixes/arm/broadcom/bcm2711-rpi-4-b.dts" 2

# 1 "./scripts/dtc/include-prefixes/arm/broadcom/bcm2711-rpi.dtsi" 1

# 1 "./scripts/dtc/include-prefixes/arm/broadcom/bcm2835-rpi.dtsi" 1


/ {
 soc {
  firmware: firmware {
   compatible = "raspberrypi,bcm2835-firmware", "simple-mfd";
   #address-cells = <1>;
   #size-cells = <1>;

   mboxes = <&mailbox>;
   dma-ranges;
  };

  power: power {
   compatible = "raspberrypi,bcm2835-power";
   firmware = <&firmware>;
   #power-domain-cells = <1>;
  };

  vchiq: mailbox@7e00b840 {
   compatible = "brcm,bcm2835-vchiq";
   reg = <0x7e00b840 0x3c>;
   interrupts = <0 2>;
  };
 };
};

&gpio {
 gpioout: gpioout {
  brcm,pins = <6>;
  brcm,function = <1>;
 };

 alt0: alt0 {
  brcm,pins = <4 5 7 8 9 10 11>;
  brcm,function = <4>;
 };
};

&i2c0mux {
 pinctrl-names = "default";
 pinctrl-0 = <&i2c0_gpio0>;
 status = "okay";
 clock-frequency = <100000>;
};

&i2c1 {
 pinctrl-names = "default";
 pinctrl-0 = <&i2c1_gpio2>;
 status = "okay";
 clock-frequency = <100000>;
};

&usb {
 power-domains = <&power 6>;
};

&vec {
 power-domains = <&power 7>;
 status = "okay";
};

&dsi0 {
 power-domains = <&power 17>;
};

&dsi1 {
 power-domains = <&power 18>;
};
# 3 "./scripts/dtc/include-prefixes/arm/broadcom/bcm2711-rpi.dtsi" 2

# 1 "./scripts/dtc/include-prefixes/dt-bindings/reset/raspberrypi,firmware-reset.h" 1
# 5 "./scripts/dtc/include-prefixes/arm/broadcom/bcm2711-rpi.dtsi" 2

/ {

 memory@0 {
  device_type = "memory";
  reg = <0 0 0>;
 };

 aliases {
  emmc2bus = &emmc2bus;
  ethernet0 = &genet;
  pcie0 = &pcie0;
  blconfig = &blconfig;
  blpubkey = &blpubkey;
 };
};

&firmware {
 firmware_clocks: clocks {
  compatible = "raspberrypi,firmware-clocks";
  #clock-cells = <1>;
 };

 expgpio: gpio {
  compatible = "raspberrypi,firmware-gpio";
  gpio-controller;
  #gpio-cells = <2>;
  status = "okay";
 };

 reset: reset {
  compatible = "raspberrypi,firmware-reset";
  #reset-cells = <1>;
 };
};

&hdmi0 {
 clocks = <&firmware_clocks 13>, <&firmware_clocks 14>, <&dvp 0>, <&clk_27MHz>;
 clock-names = "hdmi", "bvb", "audio", "cec";
 wifi-2.4ghz-coexistence;
};

&hdmi1 {
 clocks = <&firmware_clocks 13>, <&firmware_clocks 14>, <&dvp 1>, <&clk_27MHz>;
 clock-names = "hdmi", "bvb", "audio", "cec";
 wifi-2.4ghz-coexistence;
};

&hvs {
 clocks = <&firmware_clocks 4>;
};

&rmem {





 blconfig: nvram@0 {
  compatible = "raspberrypi,bootloader-config", "nvmem-rmem";
  #address-cells = <1>;
  #size-cells = <1>;
  reg = <0x0 0x0 0x0>;
  no-map;
  status = "disabled";
 };




 blpubkey: nvram@1 {
  compatible = "raspberrypi,bootloader-public-key", "nvmem-rmem";
  #address-cells = <1>;
  #size-cells = <1>;
  reg = <0x0 0x0 0x0>;
  no-map;
  status = "disabled";
 };
};

&v3d {
 clocks = <&firmware_clocks 5>;
};

&vchiq {
 interrupts = <0 34 4>;
};
# 11 "./scripts/dtc/include-prefixes/arm/broadcom/bcm2711-rpi-4-b.dts" 2

# 1 "./scripts/dtc/include-prefixes/arm/broadcom/bcm283x-rpi-led-deprecated.dtsi" 1


/ {





 leds: leds {
  compatible = "gpio-leds";

  led_act: led-act {
   label = "ACT";
   default-state = "keep";
   linux,default-trigger = "heartbeat";
  };
 };
};
# 13 "./scripts/dtc/include-prefixes/arm/broadcom/bcm2711-rpi-4-b.dts" 2


/ {
 compatible = "raspberrypi,4-model-b", "brcm,bcm2711";
 model = "Raspberry Pi 4 Model B";

 chosen {

  stdout-path = "serial1:115200n8";
 };

 sd_io_1v8_reg: regulator-sd-io-1v8 {
  compatible = "regulator-gpio";
  regulator-name = "vdd-sd-io";
  regulator-min-microvolt = <1800000>;
  regulator-max-microvolt = <3300000>;
  regulator-boot-on;
  regulator-always-on;
  regulator-settling-time-us = <5000>;
  gpios = <&expgpio 4 0>;
  states = <1800000 0x1>,
    <3300000 0x0>;
  status = "okay";
 };

 sd_vcc_reg: regulator-sd-vcc {
  compatible = "regulator-fixed";
  regulator-name = "vcc-sd";
  regulator-min-microvolt = <3300000>;
  regulator-max-microvolt = <3300000>;
  regulator-boot-on;
  enable-active-high;
  gpio = <&expgpio 6 0>;
 };
};

&bt {
 shutdown-gpios = <&expgpio 0 0>;
};

&ddc0 {
 status = "okay";
};

&ddc1 {
 status = "okay";
};

&expgpio {
 gpio-line-names = "BT_ON",
     "WL_ON",
     "PWR_LED_OFF",
     "GLOBAL_RESET",
     "VDD_SD_IO_SEL",
     "CAM_GPIO",
     "SD_PWR_ON",
     "SD_OC_N";
};

&gpio {
# 81 "./scripts/dtc/include-prefixes/arm/broadcom/bcm2711-rpi-4-b.dts"
 gpio-line-names = "ID_SDA",
     "ID_SCL",
     "GPIO2",
     "GPIO3",
     "GPIO4",
     "GPIO5",
     "GPIO6",
     "GPIO7",
     "GPIO8",
     "GPIO9",
     "GPIO10",
     "GPIO11",
     "GPIO12",
     "GPIO13",

     "GPIO14",
     "GPIO15",
     "GPIO16",
     "GPIO17",
     "GPIO18",
     "GPIO19",
     "GPIO20",
     "GPIO21",
     "GPIO22",
     "GPIO23",
     "GPIO24",
     "GPIO25",
     "GPIO26",
     "GPIO27",
     "RGMII_MDIO",
     "RGMIO_MDC",

     "CTS0",
     "RTS0",
     "TXD0",
     "RXD0",

     "SD1_CLK",
     "SD1_CMD",
     "SD1_DATA0",
     "SD1_DATA1",
     "SD1_DATA2",
     "SD1_DATA3",

     "PWM0_MISO",
     "PWM1_MOSI",
     "STATUS_LED_G_CLK",
     "SPIFLASH_CE_N",
     "SDA0",
     "SCL0",
     "RGMII_RXCLK",
     "RGMII_RXCTL",
     "RGMII_RXD0",
     "RGMII_RXD1",
     "RGMII_RXD2",
     "RGMII_RXD3",
     "RGMII_TXCLK",
     "RGMII_TXCTL",
     "RGMII_TXD0",
     "RGMII_TXD1",
     "RGMII_TXD2",
     "RGMII_TXD3";
};

&hdmi0 {
 status = "okay";
};

&hdmi1 {
 status = "okay";
};

&led_act {
 gpios = <&gpio 42 0>;
};

&leds {
 led_pwr: led-pwr {
  label = "PWR";
  gpios = <&expgpio 2 1>;
  default-state = "keep";
  linux,default-trigger = "default-on";
 };
};

&pixelvalve0 {
 status = "okay";
};

&pixelvalve1 {
 status = "okay";
};

&pixelvalve2 {
 status = "okay";
};

&pixelvalve4 {
 status = "okay";
};

&pwm1 {
 pinctrl-names = "default";
 pinctrl-0 = <&pwm1_0_gpio40 &pwm1_1_gpio41>;
 status = "okay";
};


&emmc2 {
 vqmmc-supply = <&sd_io_1v8_reg>;
 vmmc-supply = <&sd_vcc_reg>;
 broken-cd;
 status = "okay";
};

&genet {
 phy-handle = <&phy1>;
 phy-mode = "rgmii-rxid";
 status = "okay";
};

&genet_mdio {
 phy1: ethernet-phy@1 {

  reg = <0x1>;
 };
};

&pcie0 {
 pci@0,0 {
  device_type = "pci";
  #address-cells = <3>;
  #size-cells = <2>;
  ranges;

  reg = <0 0 0 0 0>;

  usb@0,0 {
   reg = <0 0 0 0 0>;
   resets = <&reset 0>;
  };
 };
};


&uart0 {
 pinctrl-names = "default";
 pinctrl-0 = <&uart0_ctsrts_gpio30 &uart0_gpio32>;
 uart-has-rtscts;
};


&uart1 {
 pinctrl-names = "default";
 pinctrl-0 = <&uart1_gpio14>;
 status = "okay";
};

&vc4 {
 status = "okay";
};

&vec {
 status = "disabled";
};

&wifi_pwrseq {
 reset-gpios = <&expgpio 1 1>;
};




# 1 "./scripts/dtc/include-prefixes/arm/broadcom/bcm271x-rpi-bt.dtsi" 1


&uart0 {
 bt: bluetooth {
  compatible = "brcm,bcm43438-bt";
  max-speed = <3000000>;
  shutdown-gpios = <&expgpio 0 0>;
  local-bd-address = [ 00 00 00 00 00 00 ];
  fallback-bd-address;
  status = "okay";
 };
};

&uart1 {
 minibt: bluetooth {
  compatible = "brcm,bcm43438-bt";
  max-speed = <230400>;
  shutdown-gpios = <&expgpio 0 0>;
  local-bd-address = [ 00 00 00 00 00 00 ];
  fallback-bd-address;
  status = "disabled";
 };
};

/ {
 chosen {
  bootargs = "coherent_pool=1M 8250.nr_uarts=1 snd_bcm2835.enable_headphones=0 cgroup_disable=memory";
 };

 aliases {
  bluetooth = &bt;
 };

 __overrides__ {
  bdaddr = <&bt>,"local-bd-address[",
         <&bt>,"fallback-bd-address?=0",
         <&minibt>,"local-bd-address[",
         <&minibt>,"fallback-bd-address?=0";
  krnbt = <&bt>,"status";
  krnbt_baudrate = <&bt>,"max-speed:0", <&minibt>,"max-speed:0";
 };
};
# 255 "./scripts/dtc/include-prefixes/arm/broadcom/bcm2711-rpi-4-b.dts" 2

/ {
 soc {
  /delete-node/ pixelvalve@7e807000;
  /delete-node/ hdmi@7e902000;
 };
};

# 1 "./scripts/dtc/include-prefixes/arm/broadcom/bcm2711-rpi-ds.dtsi" 1

# 1 "./scripts/dtc/include-prefixes/arm/broadcom/bcm270x-rpi.dtsi" 1


/ {
 aliases: aliases {
  aux = &aux;
  sound = &sound;
  soc = &soc;
  dma = &dma;
  intc = &intc;
  watchdog = &watchdog;
  random = &random;
  mailbox = &mailbox;
  gpio = &gpio;
  uart0 = &uart0;
  uart1 = &uart1;
  sdhost = &sdhost;
  mmc = &mmc;
  mmc1 = &mmc;
  mmc0 = &sdhost;
  i2s = &i2s;
  i2c0 = &i2c0;
  i2c1 = &i2c1;
  i2c10 = &i2c_csi_dsi;
  i2c = &i2c_arm;
  spi0 = &spi0;
  spi1 = &spi1;
  spi2 = &spi2;
  usb = &usb;
  leds = &leds;
  fb = &fb;
  thermal = &thermal;
  axiperf = &axiperf;
 };


 vdd_3v3_reg: fixedregulator_3v3 {
  compatible = "regulator-fixed";
  regulator-always-on;
  regulator-max-microvolt = <3300000>;
  regulator-min-microvolt = <3300000>;
  regulator-name = "3v3";
 };

 vdd_5v0_reg: fixedregulator_5v0 {
  compatible = "regulator-fixed";
  regulator-always-on;
  regulator-max-microvolt = <5000000>;
  regulator-min-microvolt = <5000000>;
  regulator-name = "5v0";
 };

 soc {
  gpiomem {
   compatible = "brcm,bcm2835-gpiomem";
   reg = <0x7e200000 0x1000>;
  };

  fb: fb {
   compatible = "brcm,bcm2708-fb";
   firmware = <&firmware>;
   status = "okay";
  };


  sound: sound {
   status = "disabled";
  };
 };

 __overrides__ {
  cache_line_size;

  uart0 = <&uart0>,"status";
  uart1 = <&uart1>,"status";
  i2s = <&i2s>,"status";
  spi = <&spi0>,"status";
  i2c0 = <&i2c0if>,"status",<&i2c0mux>,"status";
  i2c1 = <&i2c1>,"status";
  i2c = <&i2c1>,"status";
  i2c_arm = <&i2c1>,"status";
  i2c_vc = <&i2c0if>,"status",<&i2c0mux>,"status";
  i2c0_baudrate = <&i2c0if>,"clock-frequency:0";
  i2c1_baudrate = <&i2c1>,"clock-frequency:0";
  i2c_baudrate = <&i2c1>,"clock-frequency:0";
  i2c_arm_baudrate = <&i2c1>,"clock-frequency:0";
  i2c_vc_baudrate = <&i2c0if>,"clock-frequency:0";

  watchdog = <&watchdog>,"status";
  random = <&random>,"status";
  sd_overclock = <&sdhost>,"brcm,overclock-50:0";
  sd_force_pio = <&sdhost>,"brcm,force-pio?";
  sd_pio_limit = <&sdhost>,"brcm,pio-limit:0";
  sd_debug = <&sdhost>,"brcm,debug";
  sdio_overclock = <&mmc>,"brcm,overclock-50:0",
     <&mmcnr>,"brcm,overclock-50:0";
  axiperf = <&axiperf>,"status";
  drm_fb0_vc4 = <&aliases>, "drm-fb0=",&vc4;
  drm_fb1_vc4 = <&aliases>, "drm-fb1=",&vc4;
  drm_fb2_vc4 = <&aliases>, "drm-fb2=",&vc4;

  cam1_sync = <&csi1>, "sync-gpios:0=", <&gpio>,
       <&csi1>, "sync-gpios:4",
       <&csi1>, "sync-gpios:8=", <0>;
  cam1_sync_inverted = <&csi1>, "sync-gpios:0=", <&gpio>,
       <&csi1>, "sync-gpios:4",
       <&csi1>, "sync-gpios:8=", <1>;
  cam0_sync = <&csi0>, "sync-gpios:0=", <&gpio>,
       <&csi0>, "sync-gpios:4",
       <&csi0>, "sync-gpios:8=", <0>;
  cam0_sync_inverted = <&csi0>, "sync-gpios:0=", <&gpio>,
       <&csi0>, "sync-gpios:4",
       <&csi0>, "sync-gpios:8=", <1>;

  cam0_reg = <&cam0_reg>,"status";
  cam0_reg_gpio = <&cam0_reg>,"gpio:4",
    <&cam0_reg>,"gpio:0=", <&gpio>;
  cam1_reg = <&cam1_reg>,"status";
  cam1_reg_gpio = <&cam1_reg>,"gpio:4",
    <&cam1_reg>,"gpio:0=", <&gpio>;

  strict_gpiod = <&chosen>, "bootargs=pinctrl_bcm2835.persist_gpio_outputs=n";
 };
};

&uart0 {
 skip-init;
};

&uart1 {
 skip-init;
};

&txp {
 status = "disabled";
};

&i2c0if {
 status = "disabled";
};

&i2c0mux {
 pinctrl-names = "i2c0", "i2c_csi_dsi";
 /delete-property/ clock-frequency;
 status = "disabled";
};

&i2c1 {
 status = "disabled";
};

i2s_clk_producer: &i2s {};
i2s_clk_consumer: &i2s {};

&clocks {
 firmware = <&firmware>;
};

&sdhci {
 pinctrl-names = "default";
 pinctrl-0 = <&emmc_gpio48>;
 bus-width = <4>;
};

&cpu_thermal {

 thermal_trips: trips {
  cpu-crit {

   temperature = <110000>;
  };
 };
 cooling_maps: cooling-maps {
 };
};

&vec {
 clocks = <&firmware_clocks 15>;
 status = "disabled";
};

&firmware {







 vcio: vcio {
  compatible = "raspberrypi,vcio";
 };
};

&vc4 {
 raspberrypi,firmware = <&firmware>;
};
# 3 "./scripts/dtc/include-prefixes/arm/broadcom/bcm2711-rpi-ds.dtsi" 2

/ {
 chosen {
  bootargs = "coherent_pool=1M 8250.nr_uarts=1 snd_bcm2835.enable_headphones=0 cgroup_disable=memory numa_policy=interleave";
 };

 __overrides__ {
  arm_freq;
  eee = <&chosen>,"bootargs{on='',off='genet.eee=N'}";
  hdmi = <&hdmi0>,"status",
         <&hdmi1>,"status";
  nvmem_cust_rw = <&nvmem_cust>,"rw?";
  nvmem_priv_rw = <&nvmem_priv>,"rw?";
  pcie = <&pcie0>,"status";
  sd = <&emmc2>,"status";

  sd_poll_once = <&emmc2>, "non-removable?";
  spi_dma4 = <&spi0>, "dmas:0=", <&dma40>,
      <&spi0>, "dmas:8=", <&dma40>;
  i2s_dma4 = <&i2s>, "dmas:0=", <&dma40>,
      <&i2s>, "dmas:8=", <&dma40>;
 };

 scb: scb {

 };

 soc: soc {

 };

 arm-pmu {
  compatible = "arm,cortex-a72-pmu", "arm,armv8-pmuv3", "arm,cortex-a7-pmu";

 };

 chosen {
  stdout-path = "serial0:115200n8";
 };

 aliases {
  uart2 = &uart2;
  uart3 = &uart3;
  uart4 = &uart4;
  uart5 = &uart5;
  serial0 = &uart1;
  serial1 = &uart0;
  serial2 = &uart2;
  serial3 = &uart3;
  serial4 = &uart4;
  serial5 = &uart5;
  mmc0 = &emmc2;
  mmc1 = &mmcnr;
  mmc2 = &sdhost;
  i2c3 = &i2c3;
  i2c4 = &i2c4;
  i2c5 = &i2c5;
  i2c6 = &i2c6;
  i2c20 = &ddc0;
  i2c21 = &ddc1;
  spi3 = &spi3;
  spi4 = &spi4;
  spi5 = &spi5;
  spi6 = &spi6;
  /delete-property/ intc;
 };





 zone_dma {
  #address-cells = <1>;
  #size-cells = <1>;
  dma-ranges = <0x0 0x0 0x0 0x40000000>;
 };
};

&vc4 {
 raspberrypi,firmware = <&firmware>;
};

&cma {

 alloc-ranges = <0x0 0x00000000 0x30000000>;
};

&soc {

 dma-ranges = <0xc0000000 0x0 0x00000000 0x40000000>,
       <0x7c000000 0x0 0xfc000000 0x03800000>;
 nvmem {
  compatible = "simple-bus";
  #address-cells = <1>;
  #size-cells = <1>;

  nvmem_otp: nvmem_otp {
   compatible = "raspberrypi,rpi-otp";
   firmware = <&firmware>;
   reg = <0 166>;
   status = "okay";
  };

  nvmem_cust: nvmem_cust {
   compatible = "raspberrypi,rpi-otp";
   firmware = <&firmware>;
   reg = <1 8>;
   status = "okay";
  };

  nvmem_priv: nvmem_priv {
   compatible = "raspberrypi,rpi-otp";
   firmware = <&firmware>;
   reg = <3 8>;
   status = "okay";
  };
 };
};

&scb {
 #size-cells = <2>;

 ranges = <0x0 0x7c000000 0x0 0xfc000000 0x0 0x03800000>,
   <0x0 0x40000000 0x0 0xff800000 0x0 0x00800000>,
   <0x6 0x00000000 0x6 0x00000000 0x0 0x80000000>,
   <0x0 0x00000000 0x0 0x00000000 0x0 0xfc000000>;
 dma-ranges = <0x4 0x7c000000 0x0 0xfc000000 0x0 0x03800000>,
       <0x0 0x00000000 0x0 0x00000000 0x4 0x00000000>;

 dma40: dma@7e007b00 {
  compatible = "brcm,bcm2711-dma";
  reg = <0x0 0x7e007b00 0x0 0x400>;
  interrupts =
   <0 89 4>,
   <0 90 4>,
   <0 91 4>,
   <0 92 4>;
  interrupt-names = "dma11",
   "dma12",
   "dma13",
   "dma14";
  #dma-cells = <1>;
  brcm,dma-channel-mask = <0x7800>;
 };

 xhci: xhci@7e9c0000 {
  compatible = "generic-xhci";
  status = "disabled";
  reg = <0x0 0x7e9c0000 0x0 0x100000>;
  interrupts = <0 176 4>;
  power-domains = <&power 6>;
 };

 codec@7eb10000 {
  compatible = "raspberrypi,rpivid-vid-decoder";
  reg = <0x0 0x7eb10000 0x0 0x1000>,
        <0x0 0x7eb00000 0x0 0x10000>;
  reg-names = "intc",
       "hevc";
  interrupts = <0 98 4>;

  clocks = <&firmware_clocks 11>;
  clock-names = "hevc";
 };
};

&pcie0 {
 reg = <0x0 0x7d500000 0x0 0x9310>;
 ranges = <0x02000000 0x0 0x80000000 0x6 0x00000000
    0x0 0x80000000>;
};

&genet {
 reg = <0x0 0x7d580000 0x0 0x10000>;
};

&dma40 {

 brcm,dma-channel-mask = <0x7000>;
};

&vchiq {
 compatible = "brcm,bcm2711-vchiq";
};

&firmwarekms {
 compatible = "raspberrypi,rpi-firmware-kms-2711";
 interrupts = <0 112 4>;
};

&smi {
 interrupts = <0 112 4>;
};

&mmc {
 interrupts = <0 126 4>;
};

&mmcnr {
 interrupts = <0 126 4>;
};

&csi0 {
 interrupts = <0 102 4>;
};

&csi1 {
 interrupts = <0 103 4>;
};

&random {
 compatible = "brcm,bcm2711-rng200";
 status = "okay";
};

&usb {

 reg = <0x7e980000 0x10000>,
       <0x7e00b200 0x200>;
 interrupts = <0 73 4>,
       <0 40 4>;
 status = "disabled";
};

&gpio {
 interrupts = <0 113 4>,
       <0 114 4>;

 spi0_pins: spi0_pins {
  brcm,pins = <9 10 11>;
  brcm,function = <4>;
 };

 spi0_cs_pins: spi0_cs_pins {
  brcm,pins = <8 7>;
  brcm,function = <1>;
 };

 spi3_pins: spi3_pins {
  brcm,pins = <1 2 3>;
  brcm,function = <7>;
 };

 spi3_cs_pins: spi3_cs_pins {
  brcm,pins = <0 24>;
  brcm,function = <1>;
 };

 spi4_pins: spi4_pins {
  brcm,pins = <5 6 7>;
  brcm,function = <7>;
 };

 spi4_cs_pins: spi4_cs_pins {
  brcm,pins = <4 25>;
  brcm,function = <1>;
 };

 spi5_pins: spi5_pins {
  brcm,pins = <13 14 15>;
  brcm,function = <7>;
 };

 spi5_cs_pins: spi5_cs_pins {
  brcm,pins = <12 26>;
  brcm,function = <1>;
 };

 spi6_pins: spi6_pins {
  brcm,pins = <19 20 21>;
  brcm,function = <7>;
 };

 spi6_cs_pins: spi6_cs_pins {
  brcm,pins = <18 27>;
  brcm,function = <1>;
 };

 i2c0_pins: i2c0 {
  brcm,pins = <0 1>;
  brcm,function = <4>;
  brcm,pull = <2>;
 };

 i2c1_pins: i2c1 {
  brcm,pins = <2 3>;
  brcm,function = <4>;
  brcm,pull = <2>;
 };

 i2c3_pins: i2c3 {
  brcm,pins = <4 5>;
  brcm,function = <2>;
  brcm,pull = <2>;
 };

 i2c4_pins: i2c4 {
  brcm,pins = <8 9>;
  brcm,function = <2>;
  brcm,pull = <2>;
 };

 i2c5_pins: i2c5 {
  brcm,pins = <12 13>;
  brcm,function = <2>;
  brcm,pull = <2>;
 };

 i2c6_pins: i2c6 {
  brcm,pins = <22 23>;
  brcm,function = <2>;
  brcm,pull = <2>;
 };

 i2s_pins: i2s {
  brcm,pins = <18 19 20 21>;
  brcm,function = <4>;
 };

 sdio_pins: sdio_pins {
  brcm,pins = <34 35 36 37 38 39>;
  brcm,function = <7>;
  brcm,pull = <0 2 2 2 2 2>;
 };

 uart2_pins: uart2_pins {
  brcm,pins = <0 1>;
  brcm,function = <3>;
  brcm,pull = <0 2>;
 };

 uart3_pins: uart3_pins {
  brcm,pins = <4 5>;
  brcm,function = <3>;
  brcm,pull = <0 2>;
 };

 uart4_pins: uart4_pins {
  brcm,pins = <8 9>;
  brcm,function = <3>;
  brcm,pull = <0 2>;
 };

 uart5_pins: uart5_pins {
  brcm,pins = <12 13>;
  brcm,function = <3>;
  brcm,pull = <0 2>;
 };
};

&emmc2 {
 mmc-ddr-3_3v;
};

&vc4 {
 status = "disabled";
};

&pixelvalve0 {
 status = "disabled";
};

&pixelvalve1 {
 status = "disabled";
};

&pixelvalve2 {
 status = "disabled";
};

&pixelvalve3 {
 status = "disabled";
};

&pixelvalve4 {
 status = "disabled";
};

&hdmi0 {
 reg = <0x7ef00700 0x300>,
       <0x7ef00300 0x200>,
       <0x7ef00f00 0x80>,
       <0x7ef00f80 0x80>,
       <0x7ef01b00 0x200>,
       <0x7ef01f00 0x400>,
       <0x7ef00200 0x80>,
       <0x7ef04300 0x100>,
       <0x7ef20000 0x100>,
       <0x7ef00100 0x30>;
 reg-names = "hdmi",
      "dvp",
      "phy",
      "rm",
      "packet",
      "metadata",
      "csc",
      "cec",
      "hd",
      "intr2";
 clocks = <&firmware_clocks 13>,
   <&firmware_clocks 14>,
   <&dvp 0>,
   <&clk_27MHz>;
 dmas = <&dma40 (10|(1<<30)|(1<<24)|(10<<16)|(15<<20))>;
 status = "disabled";
};

&ddc0 {
 status = "disabled";
};

&hdmi1 {
 reg = <0x7ef05700 0x300>,
       <0x7ef05300 0x200>,
       <0x7ef05f00 0x80>,
       <0x7ef05f80 0x80>,
       <0x7ef06b00 0x200>,
       <0x7ef06f00 0x400>,
       <0x7ef00280 0x80>,
       <0x7ef09300 0x100>,
       <0x7ef20000 0x100>,
       <0x7ef00100 0x30>;
 reg-names = "hdmi",
      "dvp",
      "phy",
      "rm",
      "packet",
      "metadata",
      "csc",
      "cec",
      "hd",
      "intr2";
 clocks = <&firmware_clocks 13>,
   <&firmware_clocks 14>,
   <&dvp 1>,
   <&clk_27MHz>;
 dmas = <&dma40 (17|(1<<30)|(1<<24)|(10<<16)|(15<<20))>;
 status = "disabled";
};

&ddc1 {
 status = "disabled";
};

&dvp {
 status = "disabled";
};

&vec {
 clocks = <&firmware_clocks 15>;
};

&aon_intr {
 interrupts = <0 96 1>;
 status = "disabled";
};

&system_timer {
 status = "disabled";
};

&i2c0 {
      /delete-property/ compatible;
      /delete-property/ interrupts;
};

&i2c0if {
 compatible = "brcm,bcm2711-i2c", "brcm,bcm2835-i2c";
 interrupts = <0 117 4>;
};

i2c_arm: &i2c1 {};
i2c_vc: &i2c0 {};

&i2c3 {
 pinctrl-0 = <&i2c3_pins>;
 pinctrl-names = "default";
};

&i2c4 {
 pinctrl-0 = <&i2c4_pins>;
 pinctrl-names = "default";
};

&i2c5 {
 pinctrl-0 = <&i2c5_pins>;
 pinctrl-names = "default";
};

&i2c6 {
 pinctrl-0 = <&i2c6_pins>;
 pinctrl-names = "default";
};

&spi3 {
 pinctrl-0 = <&spi3_pins &spi3_cs_pins>;
 pinctrl-names = "default";
};

&spi4 {
 pinctrl-0 = <&spi4_pins &spi4_cs_pins>;
 pinctrl-names = "default";
};

&spi5 {
 pinctrl-0 = <&spi5_pins &spi5_cs_pins>;
 pinctrl-names = "default";
};

&spi6 {
 pinctrl-0 = <&spi6_pins &spi6_cs_pins>;
 pinctrl-names = "default";
};

&uart2 {
 pinctrl-0 = <&uart2_pins>;
 pinctrl-names = "default";
};

&uart3 {
 pinctrl-0 = <&uart3_pins>;
 pinctrl-names = "default";
};

&uart4 {
 pinctrl-0 = <&uart4_pins>;
 pinctrl-names = "default";
};

&uart5 {
 pinctrl-0 = <&uart5_pins>;
 pinctrl-names = "default";
};

&axiperf {
 compatible = "brcm,bcm2711-axiperf";
};

/delete-node/ &v3d;

/ {
 v3dbus: v3dbus {
  compatible = "simple-bus";
  #address-cells = <1>;
  #size-cells = <2>;
  ranges = <0x7c500000 0x0 0xfc500000 0x0 0x03300000>,
    <0x40000000 0x0 0xff800000 0x0 0x00800000>;
  dma-ranges = <0x00000000 0x0 0x00000000 0x4 0x00000000>;

  v3d: v3d@7ec04000 {
   compatible = "brcm,2711-v3d";
   reg =
       <0x7ec00000 0x0 0x4000>,
       <0x7ec04000 0x0 0x4000>;
   reg-names = "hub", "core0";

   power-domains = <&pm 1>;
   resets = <&pm 0>;
   clocks = <&firmware_clocks 5>;
   clocks-names = "v3d";
   interrupts = <0 74 4>;
   status = "disabled";
  };
 };
};
# 264 "./scripts/dtc/include-prefixes/arm/broadcom/bcm2711-rpi-4-b.dts" 2
# 1 "./scripts/dtc/include-prefixes/arm/broadcom/bcm283x-rpi-csi1-2lane.dtsi" 1

&csi1 {
 brcm,num-data-lanes = <2>;
};
# 265 "./scripts/dtc/include-prefixes/arm/broadcom/bcm2711-rpi-4-b.dts" 2
# 1 "./scripts/dtc/include-prefixes/arm/broadcom/bcm283x-rpi-i2c0mux_0_44.dtsi" 1
&i2c0mux {
 pinctrl-0 = <&i2c0_gpio0>;
 pinctrl-1 = <&i2c0_gpio44>;
};
# 266 "./scripts/dtc/include-prefixes/arm/broadcom/bcm2711-rpi-4-b.dts" 2

/ {
 /delete-node/ wifi-pwrseq;
};

&mmcnr {
 pinctrl-names = "default";
 pinctrl-0 = <&sdio_pins>;
 bus-width = <4>;
 status = "okay";
};

&uart0 {
 pinctrl-0 = <&uart0_pins &bt_pins>;
 status = "okay";
};

&uart1 {
 pinctrl-0 = <&uart1_pins>;
};

&spi0 {
 pinctrl-names = "default";
 pinctrl-0 = <&spi0_pins &spi0_cs_pins>;
 cs-gpios = <&gpio 8 1>, <&gpio 7 1>;

 spidev0: spidev@0{
  compatible = "spidev";
  reg = <0>;
  #address-cells = <1>;
  #size-cells = <0>;
  spi-max-frequency = <125000000>;
 };

 spidev1: spidev@1{
  compatible = "spidev";
  reg = <1>;
  #address-cells = <1>;
  #size-cells = <0>;
  spi-max-frequency = <125000000>;
 };
};

&gpio {
 gpio-line-names = "ID_SDA",
     "ID_SCL",
     "GPIO2",
     "GPIO3",
     "GPIO4",
     "GPIO5",
     "GPIO6",
     "GPIO7",
     "GPIO8",
     "GPIO9",
     "GPIO10",
     "GPIO11",
     "GPIO12",
     "GPIO13",
     "GPIO14",
     "GPIO15",
     "GPIO16",
     "GPIO17",
     "GPIO18",
     "GPIO19",
     "GPIO20",
     "GPIO21",
     "GPIO22",
     "GPIO23",
     "GPIO24",
     "GPIO25",
     "GPIO26",
     "GPIO27",
     "RGMII_MDIO",
     "RGMIO_MDC",

     "CTS0",
     "RTS0",
     "TXD0",
     "RXD0",

     "SD1_CLK",
     "SD1_CMD",
     "SD1_DATA0",
     "SD1_DATA1",
     "SD1_DATA2",
     "SD1_DATA3",

     "PWM0_MISO",
     "PWM1_MOSI",
     "STATUS_LED_G_CLK",
     "SPIFLASH_CE_N",
     "SDA0",
     "SCL0",
     "RGMII_RXCLK",
     "RGMII_RXCTL",
     "RGMII_RXD0",
     "RGMII_RXD1",
     "RGMII_RXD2",
     "RGMII_RXD3",
     "RGMII_TXCLK",
     "RGMII_TXCTL",
     "RGMII_TXD0",
     "RGMII_TXD1",
     "RGMII_TXD2",
     "RGMII_TXD3";

 bt_pins: bt_pins {
  brcm,pins = "-";

  brcm,function = <0>;
  brcm,pull = <2>;
 };

 uart0_pins: uart0_pins {
  brcm,pins = <32 33>;
  brcm,function = <7>;
  brcm,pull = <0 2>;
 };

 uart1_pins: uart1_pins {
  brcm,pins;
  brcm,function;
  brcm,pull;
 };

 uart1_bt_pins: uart1_bt_pins {
  brcm,pins = <32 33 30 31>;
  brcm,function = <2>;
  brcm,pull = <0 2 2 0>;
 };
};

&i2c0if {
 clock-frequency = <100000>;
};

&i2c1 {
 pinctrl-names = "default";
 pinctrl-0 = <&i2c1_pins>;
 clock-frequency = <100000>;
};

&i2s {
 pinctrl-names = "default";
 pinctrl-0 = <&i2s_pins>;
};




&sdhost {
 status = "disabled";
};

&phy1 {
 led-modes = <0x00 0x08>;
};

&gpio {
 audio_pins: audio_pins {
  brcm,pins = <40 41>;
  brcm,function = <4>;
  brcm,pull = <0>;
 };
};

&led_act {
 default-state = "off";
 linux,default-trigger = "mmc0";
};

&led_pwr {
 default-state = "off";
};

&pwm1 {
 status = "disabled";
};

&vchiq {
 pinctrl-names = "default";
 pinctrl-0 = <&audio_pins>;
};

&cam1_reg {
 gpio = <&expgpio 5 0>;
};

cam0_reg: &cam_dummy_reg {
};

i2c_csi_dsi0: &i2c0 {
};

/ {
 __overrides__ {
  audio = <&chosen>,"bootargs{on='snd_bcm2835.enable_headphones=1 snd_bcm2835.enable_hdmi=1',off='snd_bcm2835.enable_headphones=0 snd_bcm2835.enable_hdmi=0'}";

  act_led_gpio = <&led_act>,"gpios:4";
  act_led_activelow = <&led_act>,"gpios:8";
  act_led_trigger = <&led_act>,"linux,default-trigger";

  pwr_led_gpio = <&led_pwr>,"gpios:4";
  pwr_led_activelow = <&led_pwr>,"gpios:8";
  pwr_led_trigger = <&led_pwr>,"linux,default-trigger";

  eth_led0 = <&phy1>,"led-modes:0";
  eth_led1 = <&phy1>,"led-modes:4";
 };
};

&gpio {
    led_pins: led_pins {
        brcm,pins = <10>;
        brcm,function = <1>;
        brcm,pull = <0>;
    };
};

&i2c1 {
 status = "okay";

 ssd1306:ssd1306@3c {
  compatible = "tnt19,ssd1306";
  reg = <0x3c>;
  status = "okay";
 };
};

/ {
 leds {
  compatible = "gpio-leds";
        pinctrl-names = "default";
        pinctrl-0 = <&led_pins>;

  led_gpio10 {
   label = "led10_gpio_ub";
         gpios = <&gpio 10 0>;
         default-state = "on";
  };
 };
};
